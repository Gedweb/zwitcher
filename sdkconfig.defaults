## sdkconfig.defaults
```kconfig
# Zigbee Configuration
CONFIG_ZB_ENABLED=y
CONFIG_ZB_ZCZR=y

# IEEE802.15.4 Configuration
CONFIG_IEEE802154_ENABLED=y

# Flash Configuration - ESP32-C6-DevKitM-1 has 4MB flash
CONFIG_ESPTOOLPY_FLASHSIZE_4MB=y
CONFIG_ESPTOOLPY_HEADER_FLASHSIZE_UPDATE=y

# Partition Table
CONFIG_PARTITION_TABLE_CUSTOM=y
CONFIG_PARTITION_TABLE_CUSTOM_FILENAME="partitions_ota.csv"

# OTA Configuration
CONFIG_ESP_ZB_OTA_UPGRADE_ENABLED=y
```
